## device/rockchip/.chips/ok3506/amp_linux_zephyr.its
```
/* SPDX-License-Identifier: BSD-3-Clause */
/*
 * Copyright (c) 2024 Rockchip Electronics Co., Ltd.
 */

/dts-v1/;
/ {
	description = "FIT source file for rockchip AMP (Zephyr experiment)";
	#address-cells = <1>;

	images {
		amp2 {
			description  = "zephyr-core2";
			data         = /incbin/("zephyr.bin");
			type         = "firmware";
			compression  = "none";
			arch         = "arm";
			cpu          = <0xf02>;
			thumb        = <0>;
			hyp          = <0>;
			load         = <0x03e00000>;
			srambase     = <0xfff80000>;
			sramsize     = <0x0000c000>;
			compile {
				size               = <0x00100000>;
				sys                = "zephyr";
				core               = "ap";
				/* Build paths are defined once in amp-zephyr.cfg. */
			};
			udelay       = <10000>;
			hash {
				algo = "sha256";
			};
		};
	};

	share {
		rpmsg_base       = <0x03c00000>;
		rpmsg_size       = <0x00200000>;
	};

	configurations {
		default = "conf";
		conf {
			description = "Rockchip AMP images (Zephyr experiment)";
			rollback-index = <0x0>;
			loadables = "amp2";

			signature {
				algo = "sha256,rsa2048";
				padding = "pss";
				key-name-hint = "dev";
				sign-images = "loadables";
			};

			linux {
				description  = "linux-os";
				arch         = "arm";
				cpu          = <0xf00>;
				thumb        = <0>;
				hyp          = <0>;
				load         = <0x00900000>;
				udelay       = <0>;
			};
		};
	};
};
```

## zephyr/boards/forlinx/ok3506b_s12/Kconfig.ok3506b_s12_amp_uart1
```kconfig
# SPDX-License-Identifier: Apache-2.0

config BOARD_OK3506B_S12_AMP_UART1
	select SOC_RK3506
```

## zephyr/boards/forlinx/ok3506b_s12/board.yml
```yaml
board:
  name: ok3506b_s12_amp_uart1
  full_name: Forlinx OK3506B-S12 AMP UART1 CPU2
  vendor: forlinx
  socs:
    - name: rk3506
```

## zephyr/drivers/can/Kconfig.rk3506
```kconfig
# SPDX-License-Identifier: Apache-2.0

config CAN_RK3506
	bool "Rockchip RK3506 CAN controller"
	default y
	depends on CAN
	depends on SOC_RK3506
	depends on DT_HAS_ROCKCHIP_RK3506_CANFD_ENABLED
	select CLOCK_CONTROL
	select CLOCK_CONTROL_RK3506_CRU
	select PINCTRL
	select RESET
	select RESET_RK3506_CRU
	help
	  Enable the Rockchip RK3506 CAN controller driver.  The hardware block
	  is CAN-FD capable, but this driver currently exposes only the
	  board-validated Classical CAN API subset.

if CAN_RK3506

config CAN_RK3506_MAX_FILTERS
	int "Maximum number of software RX filters"
	default 8
	range 1 32
	help
	  Number of software filters applied after the hardware acceptance
	  filters admit frames into the internal RX storage.

endif # CAN_RK3506
```

## zephyr/drivers/clock_control/Kconfig.rk3506
```kconfig
# SPDX-License-Identifier: Apache-2.0

config CLOCK_CONTROL_RK3506_CRU
	bool "Rockchip RK3506 CRU clock controller"
	default y
	depends on CLOCK_CONTROL
	depends on SOC_RK3506
	depends on DT_HAS_ROCKCHIP_RK3506_CRU_CLOCK_ENABLED
	help
	  Enable minimal RK3506 CRU clock control.  The initial implementation
	  covers the CAN clocks used by the OK3506B-S12 AMP BSP.
```

## zephyr/drivers/gpio/Kconfig.rk3506
```kconfig
# RK3506 GPIO configuration options

# Copyright (c) 2026
# SPDX-License-Identifier: Apache-2.0

config GPIO_RK3506
	bool "Rockchip RK3506 GPIO driver"
	default y
	depends on DT_HAS_ROCKCHIP_RK3506_GPIO_ENABLED
	depends on SOC_RK3506
	depends on CLOCK_CONTROL
	select PINCTRL
	help
	  Enable GPIO driver for Rockchip RK3506.

	  Depends on (rather than selects) CLOCK_CONTROL: selecting it here
	  creates a dependency loop with upstream symbols that both depend on
	  CLOCK_CONTROL and select GPIO (e.g. I2S_SILABS_SIWX91X).

config GPIO_RK3506_INIT_PRIORITY
	int "RK3506 GPIO driver init priority"
	default 45
	depends on GPIO_RK3506
	help
	  RK3506 GPIO device initialization priority. Must be numerically
	  greater than the clock control and RK3506 pinctrl init priorities
	  so that clock gates and pad configuration are available during init.
```

## zephyr/drivers/pinctrl/Kconfig.rk3506
```kconfig
# SPDX-License-Identifier: Apache-2.0

config PINCTRL_RK3506
	bool "Rockchip RK3506 pin controller"
	default y
	depends on PINCTRL
	depends on SOC_RK3506
	depends on DT_HAS_ROCKCHIP_RK3506_PINCTRL_ENABLED
	depends on CLOCK_CONTROL
	help
	  Enable IOC/RMIO routing and pad configuration for RK3506 GPIO0..4.
	  MIPI D-PHY output pads require a separate PHY setup and are not enabled
	  by this driver.

config PINCTRL_RK3506_INIT_PRIORITY
	int "RK3506 pin controller init priority"
	default 35
	depends on PINCTRL_RK3506
	help
	  Must follow CLOCK_CONTROL_INIT_PRIORITY and precede peripheral users.
```

## zephyr/drivers/reset/Kconfig.rk3506
```kconfig
# SPDX-License-Identifier: Apache-2.0

config RESET_RK3506_CRU
	bool "Rockchip RK3506 CRU reset controller"
	default y
	depends on RESET
	depends on SOC_RK3506
	depends on DT_HAS_ROCKCHIP_RK3506_CRU_RESET_ENABLED
	help
	  Enable minimal RK3506 CRU reset control.  The initial implementation
	  covers the CAN reset lines used by the OK3506B-S12 AMP BSP.
```

## zephyr/drivers/spi/Kconfig.rk3506
```kconfig
# SPDX-License-Identifier: Apache-2.0

config SPI_RK3506
	bool "Rockchip RK3506 SPI controller"
	default y
	depends on DT_HAS_ROCKCHIP_RK3506_SPI_ENABLED
	depends on CLOCK_CONTROL && CLOCK_CONTROL_RK3506_CRU
	select PINCTRL
	help
	  Enable synchronous, controller-mode SPI0/SPI1 transfers on RK3506.
	  The controller uses polled transfers; DMA and peripheral mode are not supported.
```

## zephyr/dts/bindings/can/rockchip,rk3506-canfd.yaml
```yaml
# SPDX-License-Identifier: Apache-2.0

description: Rockchip RK3506 CAN controller

compatible: "rockchip,rk3506-canfd"

include:
  - can-controller.yaml
  - pinctrl-device.yaml

properties:
  reg:
    required: true

  interrupts:
    required: true

  clock-frequency:
    type: int
    required: true
    description: |
      Functional CAN clock frequency in Hz.  RK3506 Linux DTS assigns
      CLK_CAN0/CLK_CAN1 to 300 MHz.

  clocks:
    required: true

  clock-names:
    type: string-array
    required: true
    description: |
      Linux-compatible clock names.  RK3506 uses "baudclk" and "apb_pclk".

  resets:
    type: phandle-array
    required: true
    description: Reset phandles for the CAN core and APB reset lines.

  reset-names:
    type: string-array
    required: true
    description: |
      Linux-compatible reset names.  RK3506 uses "can" and "can-apb".

  rx-max-filters:
    type: int
    default: 5
    description: |
      RK3506 hardware has five acceptance-filter groups.  The current
      driver uses accept-all hardware filtering plus Zephyr software filters
      for the board-validated Classical CAN subset.
```

## zephyr/dts/bindings/clock/rockchip,rk3506-cru-clock.yaml
```yaml
# SPDX-License-Identifier: Apache-2.0

description: Rockchip RK3506 CRU clock controller

compatible: "rockchip,rk3506-cru-clock"

include: [base.yaml, clock-controller.yaml]

properties:
  reg:
    required: true
    description: Main CRU and PMU CRU register ranges, in that order.

  reg-names:
    required: true
    description: Must contain "cru" and "pmu".

  "#clock-cells":
    const: 1

clock-cells:
  - id
```

## zephyr/dts/bindings/gpio/rockchip,rk3506-gpio.yaml
```yaml
# Copyright (c) 2026
# SPDX-License-Identifier: Apache-2.0

description: |
  Rockchip RK3506 GPIO bank.

  Pins use bank-local pad numbering, A0=0, B0=8, C0=16, D0=24.
  GPIO0 has A0..C7 and D0; GPIO1 has A0..C7 and D0..D3;
  GPIO2 has A0..A5, B0..B7 and C0; GPIO3 has A0..A7 and B0..B6.
  GPIO4_B0..B3 are 1.8 V SARADC pads. GPIO4_A0..A5 are output-only
  MIPI D-PHY pads and remain reserved until the PHY GPIO mode is supported.

  gpio-reserved-ranges must exclude pads owned by other processors/peripherals.
  All four IRQs belong to GPIO OS groups, not pad groups A/B/C/D. In virtual
  mode the firmware must assign every exposed GPIO to rockchip,irq-group
  before starting Zephyr. The driver does not change virtual ownership.

  GPIO0_D0 and GPIO4 do not support hardware open drain. GPIO4_B0..B3
  share pull, drive and Schmitt settings; set these in a pinctrl state
  containing all four pads. Per-pin GPIO pull requests return ENOTSUP there.
  With no GPIO pull flag, GPIO4 preserves the pinctrl group's bias.

compatible: "rockchip,rk3506-gpio"

include: [gpio-controller.yaml, base.yaml, pinctrl-device.yaml]

properties:
  reg:
    required: true
    description: The complete 16 KiB GPIO block, including all four OS windows.

  interrupts:
    required: true
    description: GPIO group 0, 1, 2 and 3 interrupts, in that order.

  clocks:
    required: true
    description: GPIO APB clock.

  rockchip,bank-id:
    type: int
    required: true
    enum: [0, 1, 2, 3, 4]

  rockchip,irq-group:
    type: int
    default: 0
    enum: [0, 1, 2, 3]
    description: |
      OS group interrupt assigned exclusively to this driver. Group 0 is the
      normal single-OS default. AMP board configurations must choose a group
      not serviced by Linux. With virtual mode disabled, only pins requested
      for interrupts are routed into this group. Output-only use does not
      enable a GIC interrupt or alter group routing.

  "#gpio-cells":
    const: 2

  ngpios:
    type: int
    required: true
    description: Pin number span, including holes excluded by gpio-reserved-ranges.

gpio-cells:
  - pin
  - flags
```

## zephyr/dts/bindings/mbox/rockchip,rk3506-mailbox.yaml
```yaml
# SPDX-License-Identifier: Apache-2.0

description: Rockchip RK3506 mailbox register block

compatible: "rockchip,rk3506-mailbox"

include: base.yaml

properties:
  reg:
    required: true

  interrupts:
    required: true
```

## zephyr/dts/bindings/pinctrl/rockchip,rk3506-pinctrl.yaml
```yaml
# SPDX-License-Identifier: Apache-2.0

description: |
  Rockchip RK3506 IOC/RMIO pin controller for GPIO0..GPIO4.

  RK3506_PINMUX(bank, pin, mux, rmio_func) encodes one 32-bit cell:
    - bank: GPIO bank 0..4
    - pin: bank-local pad number, A0=0, B0=8, C0=16, D0=24
    - mux: implemented IOC mux value, verified separately for each pad
    - rmio_func: 0..0x62 for mux 7 on an RMIO-capable pad, otherwise 0

  RK3506_PINCTRL(group, pin, mux, rmio_func) is retained for existing GPIO0
  group-based definitions. Use the macros, not hand-encoded literal cells.
  RMIO is available on GPIO0_A0..C7 and GPIO1_B1..B3, C2/C3, D1..D3.

  A state can reference several configuration nodes. Each node may contain
  multiple pinmux cells sharing the same electrical configuration. Properties
  omitted from a node leave the corresponding electrical setting unchanged.
  GPIO0_D0 has separate drive, pull and Schmitt fields and no open drain.
  GPIO4_B0..B3 support mux 0 (GPIO/input buffer enabled) and mux 1 (analog/
  input buffer disabled). They share bias, Schmitt, drive and slew fields;
  any state changing these fields must include all four pads with identical
  shared settings. Input enable remains per-pin. GPIO4 has no open drain.
  GPIO4_A0..A5 require a separate MIPI D-PHY mode setup, not an IOC mux;
  configuration of these output-only pads currently returns ENOTSUP.

compatible: "rockchip,rk3506-pinctrl"

include: base.yaml

properties:
  reg:
    required: true
    description: GPIO0 IOC, GPIO1 IOC, GPIO234 IOC and RMIO register ranges.

  reg-names:
    required: true
    description: Must contain "ioc0", "ioc1", "ioc234" and "rmio".

  clocks:
    required: true
    description: APB clocks for GPIO0 IOC, GPIO1 IOC and GPIO234 IOC.

  clock-names:
    required: true
    description: Must contain "ioc0", "ioc1" and "ioc234".

child-binding:
  description: RK3506 pin group.

  include:
    - name: pincfg-node.yaml
      property-allowlist:
        - bias-disable
        - bias-pull-up
        - bias-pull-down
        - input-enable
        - input-disable
        - input-schmitt-enable
        - input-schmitt-disable
        - drive-push-pull
        - drive-open-drain
        - slew-rate

  properties:
    pinmux:
      required: true
      type: array
      description: One 32-bit RK3506_PINMUX(bank, pin, mux, rmio_func) cell per pin.

    slew-rate:
      enum: [0, 1, 2, 3]
      description: |
        IOC slew encoding. Regular pads accept 0..3 (slowest to fastest);
        GPIO0_D0 and SARADC pads accept only 0 or 1 (disabled or enabled).

    rockchip,drive-strength-level:
      type: int
      enum: [0, 1, 2, 3, 4, 5]
      description: |
        TRM drive-strength level, not current in mA. Regular pads accept
        levels 0..5; GPIO0_D0 and SARADC pads accept only levels 0..3.
        Omission preserves the existing setting.
```

## zephyr/dts/bindings/reset/rockchip,rk3506-cru-reset.yaml
```yaml
# SPDX-License-Identifier: Apache-2.0

description: Rockchip RK3506 CRU reset controller

compatible: "rockchip,rk3506-cru-reset"

include: [base.yaml, reset-controller.yaml]

properties:
  cru:
    type: phandle
    required: true
    description: RK3506 CRU MMIO provider node.

  "#reset-cells":
    const: 1

reset-cells:
  - id
```

## zephyr/dts/bindings/spi/rockchip,rk3506-spi.yaml
```yaml
# SPDX-License-Identifier: Apache-2.0

description: Rockchip RK3506 SPI controller

compatible: "rockchip,rk3506-spi"

include: [spi-controller.yaml, pinctrl-device.yaml]

properties:
  reg:
    required: true

  clocks:
    required: true

  clock-names:
    required: true

  pinctrl-0:
    description: |
      SPI pad mux, configured only after Linux has released these pins.
      Omit for internal controller loopback without external pins.
```
