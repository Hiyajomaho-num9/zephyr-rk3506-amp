## CMakeLists.txt
```
# SPDX-License-Identifier: Apache-2.0

cmake_minimum_required(VERSION 3.20.0)

get_filename_component(RK3506_ZEPHYR_ROOT
  "${CMAKE_CURRENT_SOURCE_DIR}/../../.."
  ABSOLUTE
)
# SDK direct builds invoke this as a freestanding app. Keep these roots as
# compatibility glue; zephyr/module.yml is the official module entry point.
list(APPEND BOARD_ROOT "${RK3506_ZEPHYR_ROOT}")
list(APPEND SOC_ROOT "${RK3506_ZEPHYR_ROOT}")
list(APPEND DTS_ROOT "${RK3506_ZEPHYR_ROOT}")

find_package(Zephyr REQUIRED HINTS $ENV{ZEPHYR_BASE})
project(rk3506_amp_cache_stress)

target_include_directories(app PRIVATE
  src
)

target_sources(app PRIVATE
  src/main.c
  src/rk3506_rpmsg_demo.c
)

target_sources_ifdef(CONFIG_SOC_RK3506_AMP_PROBE app PRIVATE
  src/rk3506_amp_probe.c
)

target_sources_ifdef(CONFIG_SOC_RK3506_CACHE_THRASH app PRIVATE
  src/rk3506_cache_thrash.c
)
```

## prj.conf
```kconfig
# SPDX-License-Identifier: Apache-2.0

CONFIG_SERIAL=y
CONFIG_CONSOLE=y
CONFIG_UART_CONSOLE=y
CONFIG_PRINTK=y

CONFIG_SHELL=y
CONFIG_SHELL_BACKEND_SERIAL=y
CONFIG_SHELL_BACKEND_SERIAL_INTERRUPT_DRIVEN=n
CONFIG_SHELL_BACKEND_SERIAL_API_POLLING=y
CONFIG_SHELL_BACKEND_SERIAL_RX_POLL_PERIOD=10
CONFIG_SHELL_PROMPT_UART="rk3506:~$ "
CONFIG_SHELL_STACK_SIZE=4096
CONFIG_KERNEL_SHELL=y
CONFIG_DEVICE_SHELL=y
CONFIG_THREAD_MONITOR=y
CONFIG_THREAD_NAME=y

CONFIG_ARMV7_EXCEPTION_STACK_SIZE=8192
CONFIG_ARMV7_FIQ_STACK_SIZE=8192
CONFIG_ARMV7_SVC_STACK_SIZE=8192
CONFIG_ARMV7_SYS_STACK_SIZE=8192
CONFIG_IDLE_STACK_SIZE=8192
CONFIG_ISR_STACK_SIZE=8192
CONFIG_MAIN_STACK_SIZE=8192
CONFIG_SYSTEM_WORKQUEUE_STACK_SIZE=8192

CONFIG_HEAP_MEM_POOL_SIZE=65536
CONFIG_COMMON_LIBC_MALLOC=y
CONFIG_COMMON_LIBC_MALLOC_ARENA_SIZE=32768

# Phase 4.7 BSP baseline:
# mailbox2 IRQ176, GIC target 0x4, Group0, IRQ-only after NS announce.
# CONFIG_SOC_RK3506_RPMSG_MBOX_GIC_GROUP1 is not set
CONFIG_SOC_RK3506_RPMSG_IRQ_ONLY_AFTER_NS=y
# CONFIG_SOC_RK3506_RPMSG_KEEP_IRQ_ENABLE is not set
CONFIG_SOC_RK3506_PRIVATE_ICACHE=y
CONFIG_SOC_RK3506_PRIVATE_DCACHE=y

# Phase 5/6 validation target:
# keep verified RPMsg/cache policy, and enable validation-only diagnostics.
CONFIG_SOC_RK3506_BOOT_BANNER=y
CONFIG_SOC_RK3506_AMP_DIAGNOSTICS=y
CONFIG_SOC_RK3506_AMP_PROBE=y
CONFIG_SOC_RK3506_CACHE_THRASH=y
# CONFIG_SOC_RK3506_RPMSG_DEBUG_LOG is not set
```

## src/main.c
```c
/*
 * SPDX-License-Identifier: Apache-2.0
 */

#include <zephyr/kernel.h>
#include <zephyr/sys/printk.h>

#include "rk3506_amp_probe.h"
#include "rk3506_cache_thrash.h"
#include "rk3506_rpmsg_demo.h"
#include "rk3506_rpmsg_platform.h"

int main(void)
{
	uint32_t count = 0U;

#ifdef CONFIG_SOC_RK3506_BOOT_BANNER
	printk("[RK3506][CLEAN-ZEPHYR] main reached\n");
#endif

	rk3506_cache_thrash_start();
	rk3506_rpmsg_demo_start();

	for (;;) {
		rk3506_amp_probe_update(count);
#ifdef CONFIG_SOC_RK3506_RPMSG_DEBUG_LOG
		if ((count % 5U) == 0U) {
			printk("[RK3506][CLEAN-ZEPHYR] heartbeat %u uptime=%lld ms "
			       "mbox_rx=%u mbox_tx=%u mbox_irq=%u rpmsg_rx=%u rpmsg_tx=%u fail=%u "
			       "gic_tgt=0x%x->0x%x group=%u en=%u pend=%u act=%u pri=0x%x\n",
			       count, k_uptime_get(),
			       rk3506_rpmsg_platform_rx_count(),
			       rk3506_rpmsg_platform_tx_count(),
			       rk3506_rpmsg_platform_irq_count(),
			       rk3506_rpmsg_demo_rx_count(),
			       rk3506_rpmsg_demo_tx_count(),
			       rk3506_rpmsg_demo_tx_fail_count(),
			       rk3506_rpmsg_platform_gic_target_before(),
			       rk3506_rpmsg_platform_gic_target_after(),
			       rk3506_rpmsg_platform_gic_group(),
			       rk3506_rpmsg_platform_gic_enable(),
			       rk3506_rpmsg_platform_gic_pending(),
			       rk3506_rpmsg_platform_gic_active(),
			       rk3506_rpmsg_platform_gic_priority());
		}
#endif
		count++;
		k_sleep(K_SECONDS(1));
	}

	return 0;
}
```

## src/rk3506_amp_probe.c
```c
/*
 * SPDX-License-Identifier: Apache-2.0
 */

#include <zephyr/kernel.h>
#include <zephyr/sys/barrier.h>

#include "rk3506_amp_probe.h"
#include "rk3506_amp_layout.h"
#include "rk3506_cache_thrash.h"
#include "rk3506_rpmsg_demo.h"
#include "rk3506_rpmsg_platform.h"
#include "soc.h"

#define RK3506_AMP_SHMEM_PROBE_MAGIC 0x524b5a50U
#define RK3506_AMP_SHMEM_PROBE_VERSION 14U

struct rk3506_amp_shmem_probe {
	uint32_t magic;
	uint32_t version;
	uint32_t counter;
	uint32_t uptime_ms_lo;
	uint32_t uptime_ms_hi;
	uint32_t last_status;
	uint32_t inverse_counter;
	uint32_t mbox_debug_status;
	uint32_t mbox_irq_count;
	uint32_t mbox_last_status;
	uint32_t mbox_last_cmd;
	uint32_t mbox_last_data;
	uint32_t mbox_bad_count;
	uint32_t mbox_poll_count;
	uint32_t mbox_poll_hit_count;
	uint32_t mbox_irq_configured;
	uint32_t mbox_irq_number;
	uint32_t gic_target_before;
	uint32_t gic_target_after;
	uint32_t gic_enable;
	uint32_t gic_pending;
	uint32_t gic_active;
	uint32_t gic_priority;
	uint32_t gic_dist_ctlr;
	uint32_t gic_cpu_ctlr;
	uint32_t gic_cpu_pmr;
	uint32_t mbox_status_seen_mask;
	uint32_t mbox_status_seen_count;
	uint32_t gic_group;
	uint32_t gic_group_word;
	uint32_t gic_icfgr;
	uint32_t gic_icfgr_word;
	uint32_t gic_enable_word;
	uint32_t gic_pending_word;
	uint32_t gic_active_word;
	uint32_t mbox2_a2b_inten;
	uint32_t mbox2_a2b_status;
	uint32_t mbox2_b2a_inten;
	uint32_t mbox2_b2a_status;
	uint32_t mbox2_a2b_cmd;
	uint32_t mbox2_a2b_data;
	uint32_t mbox2_b2a_cmd;
	uint32_t mbox2_b2a_data;
	uint32_t mbox_irq_enable_count;
	uint32_t mbox_irq_disable_count;
	uint32_t mbox_irq_last_enable_vector;
	uint32_t mbox_irq_last_disable_vector;
	uint32_t compiled_flags;
	uint32_t gic_group_before;
	uint32_t gic_group_value;
	uint32_t gic_group_after;
	uint32_t gic_enable_before;
	uint32_t gic_enable_value;
	uint32_t gic_enable_after;
	uint32_t mmu_policy;
	uint32_t amp_shmem_mmu_attrs;
	uint32_t rpmsg_mmu_attrs;
	uint32_t sctlr_snapshot;
	uint32_t cache_policy;
	uint32_t sctlr_i_bit;
	uint32_t sctlr_c_bit;
	uint32_t sctlr_a_bit;
	uint32_t preflight_policy;
	uint32_t sctlr_m_bit;
	uint32_t ttbr0_snapshot;
	uint32_t dacr_snapshot;
	uint32_t ttbcr_snapshot;
	uint32_t ttbr0_low_bits;
	uint32_t normal_code_mmu_attrs;
	uint32_t normal_data_mmu_attrs;
	uint32_t normal_rodata_mmu_attrs;
	uint32_t thrash_policy;
	uint32_t thrash_counter;
	uint32_t thrash_signature;
	uint32_t thrash_error_count;
};

static volatile struct rk3506_amp_shmem_probe *const shmem_probe =
	(volatile struct rk3506_amp_shmem_probe *)RK3506_AMP_SHMEM_BASE;

void rk3506_amp_probe_update(uint32_t counter)
{
	int64_t uptime = k_uptime_get();

	shmem_probe->magic = RK3506_AMP_SHMEM_PROBE_MAGIC;
	shmem_probe->version = RK3506_AMP_SHMEM_PROBE_VERSION;
	shmem_probe->counter = counter;
	shmem_probe->uptime_ms_lo = (uint32_t)uptime;
	shmem_probe->uptime_ms_hi = (uint32_t)((uint64_t)uptime >> 32);
	shmem_probe->last_status =
		((rk3506_rpmsg_demo_rx_count() & 0xffU) << 24) |
		((rk3506_rpmsg_demo_tx_count() & 0xffU) << 16) |
		((rk3506_rpmsg_platform_rx_count() & 0xffU) << 8) |
		(rk3506_rpmsg_demo_ns_sent() & 0xffU);
	shmem_probe->inverse_counter = ~counter;
	shmem_probe->mbox_debug_status = rk3506_rpmsg_platform_debug_status();
	shmem_probe->mbox_irq_count = rk3506_rpmsg_platform_irq_count();
	shmem_probe->mbox_last_status = rk3506_rpmsg_platform_last_status();
	shmem_probe->mbox_last_cmd = rk3506_rpmsg_platform_last_cmd();
	shmem_probe->mbox_last_data = rk3506_rpmsg_platform_last_data();
	shmem_probe->mbox_bad_count = rk3506_rpmsg_platform_bad_count();
	shmem_probe->mbox_poll_count = rk3506_rpmsg_platform_poll_count();
	shmem_probe->mbox_poll_hit_count = rk3506_rpmsg_platform_poll_hit_count();
	shmem_probe->mbox_irq_configured = rk3506_rpmsg_platform_irq_configured();
	shmem_probe->mbox_irq_number = rk3506_rpmsg_platform_irq_number();
	shmem_probe->gic_target_before = rk3506_rpmsg_platform_gic_target_before();
	shmem_probe->gic_target_after = rk3506_rpmsg_platform_gic_target_after();
	shmem_probe->gic_enable = rk3506_rpmsg_platform_gic_enable();
	shmem_probe->gic_pending = rk3506_rpmsg_platform_gic_pending();
	shmem_probe->gic_active = rk3506_rpmsg_platform_gic_active();
	shmem_probe->gic_priority = rk3506_rpmsg_platform_gic_priority();
	shmem_probe->gic_dist_ctlr = rk3506_rpmsg_platform_gic_dist_ctlr();
	shmem_probe->gic_cpu_ctlr = rk3506_rpmsg_platform_gic_cpu_ctlr();
	shmem_probe->gic_cpu_pmr = rk3506_rpmsg_platform_gic_cpu_pmr();
	shmem_probe->mbox_status_seen_mask = rk3506_rpmsg_platform_status_seen_mask();
	shmem_probe->mbox_status_seen_count = rk3506_rpmsg_platform_status_seen_count();
	shmem_probe->gic_group = rk3506_rpmsg_platform_gic_group();
	shmem_probe->gic_group_word = rk3506_rpmsg_platform_gic_group_word();
	shmem_probe->gic_icfgr = rk3506_rpmsg_platform_gic_icfgr();
	shmem_probe->gic_icfgr_word = rk3506_rpmsg_platform_gic_icfgr_word();
	shmem_probe->gic_enable_word = rk3506_rpmsg_platform_gic_enable_word();
	shmem_probe->gic_pending_word = rk3506_rpmsg_platform_gic_pending_word();
	shmem_probe->gic_active_word = rk3506_rpmsg_platform_gic_active_word();
	shmem_probe->mbox2_a2b_inten = rk3506_rpmsg_platform_mbox2_a2b_inten();
	shmem_probe->mbox2_a2b_status = rk3506_rpmsg_platform_mbox2_a2b_status();
	shmem_probe->mbox2_b2a_inten = rk3506_rpmsg_platform_mbox2_b2a_inten();
	shmem_probe->mbox2_b2a_status = rk3506_rpmsg_platform_mbox2_b2a_status();
	shmem_probe->mbox2_a2b_cmd = rk3506_rpmsg_platform_mbox2_a2b_cmd();
	shmem_probe->mbox2_a2b_data = rk3506_rpmsg_platform_mbox2_a2b_data();
	shmem_probe->mbox2_b2a_cmd = rk3506_rpmsg_platform_mbox2_b2a_cmd();
	shmem_probe->mbox2_b2a_data = rk3506_rpmsg_platform_mbox2_b2a_data();
	shmem_probe->mbox_irq_enable_count = rk3506_rpmsg_platform_irq_enable_count();
	shmem_probe->mbox_irq_disable_count = rk3506_rpmsg_platform_irq_disable_count();
	shmem_probe->mbox_irq_last_enable_vector =
		rk3506_rpmsg_platform_irq_last_enable_vector();
	shmem_probe->mbox_irq_last_disable_vector =
		rk3506_rpmsg_platform_irq_last_disable_vector();
	shmem_probe->compiled_flags = rk3506_rpmsg_platform_compiled_flags();
	shmem_probe->gic_group_before = rk3506_rpmsg_platform_gic_group_before();
	shmem_probe->gic_group_value = rk3506_rpmsg_platform_gic_group_value();
	shmem_probe->gic_group_after = rk3506_rpmsg_platform_gic_group_after();
	shmem_probe->gic_enable_before = rk3506_rpmsg_platform_gic_enable_before();
	shmem_probe->gic_enable_value = rk3506_rpmsg_platform_gic_enable_value();
	shmem_probe->gic_enable_after = rk3506_rpmsg_platform_gic_enable_after();
	shmem_probe->mmu_policy = RK3506_AMP_SHARED_MMU_POLICY_STRO;
	shmem_probe->amp_shmem_mmu_attrs = rk3506_soc_amp_shmem_mmu_attrs();
	shmem_probe->rpmsg_mmu_attrs = rk3506_soc_rpmsg_mmu_attrs();
	shmem_probe->sctlr_snapshot = rk3506_soc_sctlr_snapshot();
	shmem_probe->cache_policy = rk3506_soc_cache_policy();
	shmem_probe->sctlr_i_bit = (shmem_probe->sctlr_snapshot >> 12) & 0x1U;
	shmem_probe->sctlr_c_bit = (shmem_probe->sctlr_snapshot >> 2) & 0x1U;
	shmem_probe->sctlr_a_bit = (shmem_probe->sctlr_snapshot >> 1) & 0x1U;
	shmem_probe->preflight_policy = rk3506_soc_cache_preflight_policy();
	shmem_probe->sctlr_m_bit = shmem_probe->sctlr_snapshot & 0x1U;
	shmem_probe->ttbr0_snapshot = rk3506_soc_ttbr0_snapshot();
	shmem_probe->dacr_snapshot = rk3506_soc_dacr_snapshot();
	shmem_probe->ttbcr_snapshot = rk3506_soc_ttbcr_snapshot();
	shmem_probe->ttbr0_low_bits = shmem_probe->ttbr0_snapshot & 0x7fU;
	shmem_probe->normal_code_mmu_attrs = rk3506_soc_normal_code_mmu_attrs();
	shmem_probe->normal_data_mmu_attrs = rk3506_soc_normal_data_mmu_attrs();
	shmem_probe->normal_rodata_mmu_attrs = rk3506_soc_normal_rodata_mmu_attrs();
	shmem_probe->thrash_policy = RK3506_AMP_CACHE_THRASH_POLICY;
	shmem_probe->thrash_counter = rk3506_cache_thrash_counter();
	shmem_probe->thrash_signature = rk3506_cache_thrash_signature();
	shmem_probe->thrash_error_count = rk3506_cache_thrash_error_count();
	barrier_dmem_fence_full();
}
```

## src/rk3506_amp_probe.h
```c
/*
 * SPDX-License-Identifier: Apache-2.0
 */

#ifndef RK3506_AMP_PROBE_H
#define RK3506_AMP_PROBE_H

#include <stdint.h>

#ifdef CONFIG_SOC_RK3506_AMP_PROBE
void rk3506_amp_probe_update(uint32_t counter);
#else
static inline void rk3506_amp_probe_update(uint32_t counter)
{
	(void)counter;
}
#endif

#endif /* RK3506_AMP_PROBE_H */
```

## src/rk3506_cache_thrash.c
```c
/*
 * SPDX-License-Identifier: Apache-2.0
 */

#include <zephyr/kernel.h>
#include <zephyr/sys/util.h>

#include "rk3506_cache_thrash.h"

#define RK3506_THRASH_WORDS 8192U
#define RK3506_THRASH_STACK 2048U
#define RK3506_THRASH_PRIO  8

static uint32_t thrash_a[RK3506_THRASH_WORDS] __aligned(64);
static uint32_t thrash_b[RK3506_THRASH_WORDS] __aligned(64);
static uint32_t thrash_counter;
static uint32_t thrash_signature;
static uint32_t thrash_error_count;

K_THREAD_STACK_DEFINE(rk3506_cache_thrash_stack, RK3506_THRASH_STACK);
static struct k_thread rk3506_cache_thrash_thread;

static uint32_t rk3506_thrash_mix(uint32_t x)
{
	x ^= x << 13;
	x ^= x >> 17;
	x ^= x << 5;
	return x;
}

static void rk3506_cache_thrash_worker(void *p1, void *p2, void *p3)
{
	uint32_t seed = 0x35060002U;

	ARG_UNUSED(p1);
	ARG_UNUSED(p2);
	ARG_UNUSED(p3);

	for (uint32_t i = 0U; i < RK3506_THRASH_WORDS; i++) {
		seed = rk3506_thrash_mix(seed + i);
		thrash_a[i] = seed;
		thrash_b[i] = ~seed;
	}

	for (;;) {
		uint32_t sig = 0x6b350600U ^ thrash_counter;

		for (uint32_t i = 0U; i < RK3506_THRASH_WORDS; i++) {
			uint32_t v = rk3506_thrash_mix(thrash_a[i] + i + thrash_counter);

			thrash_a[i] = v;
			thrash_b[RK3506_THRASH_WORDS - 1U - i] ^= v + i;
			sig ^= v + (sig << 3) + (sig >> 2);
		}

		/*
		 * This is a load generator.  The Linux-side stress tool asserts
		 * that this counter keeps moving; do not add probabilistic local
		 * predicates here, otherwise an 8-hour run can fail spuriously.
		 */
		thrash_signature = sig;
		thrash_counter++;
		k_yield();
	}
}

void rk3506_cache_thrash_start(void)
{
	k_thread_create(&rk3506_cache_thrash_thread, rk3506_cache_thrash_stack,
			K_THREAD_STACK_SIZEOF(rk3506_cache_thrash_stack),
			rk3506_cache_thrash_worker, NULL, NULL, NULL,
			RK3506_THRASH_PRIO, 0, K_NO_WAIT);
	k_thread_name_set(&rk3506_cache_thrash_thread, "rk3506_thrash");
}

uint32_t rk3506_cache_thrash_counter(void)
{
	return thrash_counter;
}

uint32_t rk3506_cache_thrash_signature(void)
{
	return thrash_signature;
}

uint32_t rk3506_cache_thrash_error_count(void)
{
	return thrash_error_count;
}
```

## src/rk3506_cache_thrash.h
```c
/*
 * SPDX-License-Identifier: Apache-2.0
 */

#ifndef RK3506_CACHE_THRASH_H
#define RK3506_CACHE_THRASH_H

#include <stdint.h>

#ifdef CONFIG_SOC_RK3506_CACHE_THRASH
void rk3506_cache_thrash_start(void);
uint32_t rk3506_cache_thrash_counter(void);
uint32_t rk3506_cache_thrash_signature(void);
uint32_t rk3506_cache_thrash_error_count(void);
#else
static inline void rk3506_cache_thrash_start(void)
{
}

static inline uint32_t rk3506_cache_thrash_counter(void)
{
	return 0U;
}

static inline uint32_t rk3506_cache_thrash_signature(void)
{
	return 0U;
}

static inline uint32_t rk3506_cache_thrash_error_count(void)
{
	return 0U;
}
#endif

#endif /* RK3506_CACHE_THRASH_H */
```

## src/rk3506_rpmsg_demo.c
```c
/*
 * SPDX-License-Identifier: Apache-2.0
 */

#include <string.h>

#include <zephyr/kernel.h>
#include <zephyr/sys/printk.h>

#include "rk3506_rpmsg_demo.h"
#include "rk3506_amp_layout.h"
#include "rk3506_rpmsg_platform.h"
#include "rpmsg_lite.h"
#include "rpmsg_ns.h"

#define RK3506_RPMSG_PING_PREFIX "ping:"
#define RK3506_RPMSG_PONG_PREFIX "pong:"
#define RK3506_RPMSG_REPLY_BUF_SIZE 512U

#define RK3506_RPMSG_THREAD_STACK 4096
#define RK3506_RPMSG_THREAD_PRIO 5

static struct rpmsg_lite_instance *rpmsg_dev;
static struct rpmsg_lite_endpoint *rpmsg_ept;
static uint32_t rpmsg_rx_count;
static uint32_t rpmsg_tx_count;
static uint32_t rpmsg_tx_fail_count;
static uint32_t rpmsg_ns_sent;

K_THREAD_STACK_DEFINE(rk3506_rpmsg_stack, RK3506_RPMSG_THREAD_STACK);
static struct k_thread rk3506_rpmsg_thread;

static int32_t rk3506_rpmsg_rx_cb(void *payload, uint32_t payload_len,
				  uint32_t src, void *priv)
{
	int32_t ret;
	char reply[RK3506_RPMSG_REPLY_BUF_SIZE];
	size_t suffix_len;
	size_t reply_len;

	ARG_UNUSED(priv);

	rpmsg_rx_count++;
#ifdef CONFIG_SOC_RK3506_RPMSG_DEBUG_LOG
	printk("[RK3506][RPMSG] rx%u src=0x%x len=%u: %.*s\n",
	       rpmsg_rx_count, src, payload_len,
	       (int)payload_len, (char *)payload);
#endif

	if ((payload_len <= strlen(RK3506_RPMSG_PING_PREFIX)) ||
	    memcmp(payload, RK3506_RPMSG_PING_PREFIX,
		   strlen(RK3506_RPMSG_PING_PREFIX)) != 0) {
#ifdef CONFIG_SOC_RK3506_RPMSG_DEBUG_LOG
		printk("[RK3506][RPMSG] ignore non-ping payload\n");
#endif
		return RL_RELEASE;
	}

	suffix_len = payload_len - strlen(RK3506_RPMSG_PING_PREFIX);
	reply_len = strlen(RK3506_RPMSG_PONG_PREFIX) + suffix_len;
	if (reply_len > sizeof(reply)) {
		rpmsg_tx_fail_count++;
		printk("[RK3506][RPMSG] pong payload too large: %u\n", payload_len);
		return RL_RELEASE;
	}

	memcpy(reply, RK3506_RPMSG_PONG_PREFIX,
	       strlen(RK3506_RPMSG_PONG_PREFIX));
	memcpy(reply + strlen(RK3506_RPMSG_PONG_PREFIX),
	       (char *)payload + strlen(RK3506_RPMSG_PING_PREFIX),
	       suffix_len);

	ret = rpmsg_lite_send(rpmsg_dev, rpmsg_ept, src, reply,
			      (uint32_t)reply_len, RL_DONT_BLOCK);
	if (ret == RL_SUCCESS) {
		rpmsg_tx_count++;
#ifdef CONFIG_SOC_RK3506_RPMSG_DEBUG_LOG
		printk("[RK3506][RPMSG] tx%u dst=0x%x len=%u: %.*s\n",
		       rpmsg_tx_count, src, (uint32_t)reply_len,
		       (int)reply_len, reply);
#endif
	} else {
		rpmsg_tx_fail_count++;
		printk("[RK3506][RPMSG] pong send failed: %d\n", ret);
	}

	return RL_RELEASE;
}

static void rk3506_rpmsg_worker(void *p1, void *p2, void *p3)
{
	int32_t ret;

	ARG_UNUSED(p1);
	ARG_UNUSED(p2);
	ARG_UNUSED(p3);

#ifdef CONFIG_SOC_RK3506_BOOT_BANNER
	printk("[RK3506][RPMSG] remote init: shmem=0x%08x link=0x%x\n",
	       RK3506_RPMSG_SHMEM_BASE, RK3506_RPMSG_LINK_ID);
#endif

	rpmsg_dev = rpmsg_lite_remote_init((void *)RK3506_RPMSG_SHMEM_BASE,
					   RK3506_RPMSG_LINK_ID,
					   RL_NO_FLAGS);
	if (rpmsg_dev == NULL) {
		printk("[RK3506][RPMSG] remote init failed\n");
		return;
	}

	rpmsg_ept = rpmsg_lite_create_ept(rpmsg_dev, RK3506_RPMSG_EPT_ADDR,
					  rk3506_rpmsg_rx_cb, NULL);
	if (rpmsg_ept == NULL) {
		printk("[RK3506][RPMSG] endpoint create failed\n");
		return;
	}

	while (rpmsg_lite_is_link_up(rpmsg_dev) == 0U) {
		rk3506_rpmsg_platform_poll();
		k_sleep(K_MSEC(1));
	}
#ifdef CONFIG_SOC_RK3506_BOOT_BANNER
	printk("[RK3506][RPMSG] link up\n");
#endif

	ret = rpmsg_ns_announce(rpmsg_dev, rpmsg_ept, RK3506_RPMSG_CH_NAME,
				RL_NS_CREATE);
	if (ret == RL_SUCCESS) {
		rpmsg_ns_sent = 1U;
#ifdef CONFIG_SOC_RK3506_BOOT_BANNER
		printk("[RK3506][RPMSG] ns announce: %s addr=0x%x\n",
		       RK3506_RPMSG_CH_NAME, RK3506_RPMSG_EPT_ADDR);
#endif
	} else {
		printk("[RK3506][RPMSG] ns announce failed: %d\n", ret);
	}

	rk3506_rpmsg_platform_force_irq_enable();

	for (;;) {
#ifdef CONFIG_SOC_RK3506_RPMSG_IRQ_ONLY_AFTER_NS
#ifdef CONFIG_SOC_RK3506_RPMSG_KEEP_IRQ_ENABLE
		rk3506_rpmsg_platform_force_irq_enable();
#endif
		k_sleep(K_SECONDS(1));
#else
		rk3506_rpmsg_platform_poll();
		k_sleep(K_MSEC(1));
#endif
	}
}

void rk3506_rpmsg_demo_start(void)
{
	k_thread_create(&rk3506_rpmsg_thread, rk3506_rpmsg_stack,
			K_THREAD_STACK_SIZEOF(rk3506_rpmsg_stack),
			rk3506_rpmsg_worker, NULL, NULL, NULL,
			RK3506_RPMSG_THREAD_PRIO, 0, K_NO_WAIT);
	k_thread_name_set(&rk3506_rpmsg_thread, "rk3506_rpmsg");
}

uint32_t rk3506_rpmsg_demo_rx_count(void)
{
	return rpmsg_rx_count;
}

uint32_t rk3506_rpmsg_demo_tx_count(void)
{
	return rpmsg_tx_count;
}

uint32_t rk3506_rpmsg_demo_tx_fail_count(void)
{
	return rpmsg_tx_fail_count;
}

uint32_t rk3506_rpmsg_demo_ns_sent(void)
{
	return rpmsg_ns_sent;
}
```

## src/rk3506_rpmsg_demo.h
```c
/*
 * SPDX-License-Identifier: Apache-2.0
 */

#ifndef RK3506_RPMSG_DEMO_H
#define RK3506_RPMSG_DEMO_H

#include <stdint.h>

void rk3506_rpmsg_demo_start(void);
uint32_t rk3506_rpmsg_demo_rx_count(void);
uint32_t rk3506_rpmsg_demo_tx_count(void);
uint32_t rk3506_rpmsg_demo_tx_fail_count(void);
uint32_t rk3506_rpmsg_demo_ns_sent(void);

#endif /* RK3506_RPMSG_DEMO_H */
```
